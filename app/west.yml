## app/west.yml
```yaml
manifest:
  remotes:
    - name: zephyrproject-rtos
      url-base: https://github.com/zephyrproject-rtos
    - name: zmkfirmware
      url-base: https://github.com/zmkfirmware
    - name: microsoft
      url-base: https://github.com/microsoft
  projects:
    - name: zephyr
      remote: zmkfirmware
      revision: v2.4.0+zmk-fixes
      clone-depth: 1
      import:
        # TODO: Rename once upstream offers option like `exclude` or `denylist`
        name-blacklist:
          - ci-tools
          - esp-idf
          - hal_atmel
          - hal_altera
          - hal_cypress
          - hal_infineon
          - hal_microchip
          - hal_nordic
          - hal_nxp
          - hal_openisa
          - hal_silabs
          - hal_xtensa
          - hal_st
          - hal_ti
          - loramac-node
          - mcuboot
          - mcumgr
          - net-tools
          - segger
          - openthread
          - edtt
          - trusted-firmware-m
          - civetweb
          - loramac-node
          - nrf_hw_models
  self:
    west-commands: scripts/west-commands.yml
```
